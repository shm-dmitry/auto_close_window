## esp32/main/Kconfig.projbuild
```kconfig
menu "Auto Open-Close WindowConfiguration"
   menu "WIFI Configuration"
   	  config WIFI_SSID
   	  	string "Wifi AP SSID"
   	  	default ""

   	  config WIFI_PASSWORD
   	  	string "Wifi AP Password"
   	  	default ""
   	  	
   	  config WIFI_TOPIC
   	  	string "WiFi MQTT Topic to listen Change-SSID command"
   	  	default "/acw/system/0/wifi"
   endmenu

   menu "MQTT Configuration"
      config MQTT_BROKER_URI
         string "Broker URL"
         default ""

      config MQTT_BROKER_USERNAME
	     string "Broker user name"
	     default ""

      config MQTT_BROKER_PASSWORD
	     string "Broker user password"
	     default ""

      config MQTT_INIT_LOGGER_ENABLED
	     boolean "Enable log init messages to MQTT topic"
	     default false

      config MQTT_INIT_LOGGER_TOPIC
	     string "MQTT Init logger topic"
	     default "/acw/system/0/initlogger"

      config MQTT_LIVE_LOGGER_ENABLED
	     boolean "Enable log live messages to MQTT topic"
	     default false

      config MQTT_LIVE_LOGGER_TOPIC
	     string "MQTT live logger topic"
	     default "/acw/system/0/livelogger"
   endmenu

   menu "Servo Controller Configuration"
      config CONTROLLER_SERVO_GPIO
         int "GPIO PWM pin"
         default 19
         
      config CONTROLLER_COMMAND_TOPIC
         string "MQTT topic for listen controller commands"
         default "/acw/controller/0/command"

      config CONTROLLER_STATUS_TOPIC
         string "MQTT topic for publish controller status"
         default "/acw/controller/0/status"
   endmenu
   
   menu "LED Configuration"
      config LED_GPIO
         int "LED GPIO pin"
         default 33
   endmenu

   menu "Buttons Configuration"
      config BUTTON_OPEN
         int "OPEN button pin number"
         default 4

      config BUTTON_CLOSE
         int "CLOSE button pin number"
         default 15
   endmenu

   menu "Hardware Locks Configuration"
      config HWLOCK_GPIO_HALL
         int "GPIO Hall sensor status"
         default 18

      config HWLOCK_GPIO_SWITCH
         int "GPIO switch status"
         default 16

      config HWLOCK_GPIO_SOFTLOCK
         int "GPIO soft lock"
         default 21
         
      config HWLOCK_SOFTLOCK_TOPIC
         string "MQTT topic for change soft lock status"
         default "/acw/hwlock/0/command"
         
      config HWLOCK_STATUS_TOPIC
         string "MQTT topic for hwlocks status"
         default "/acw/hwlock/0/status"
   endmenu
   
   menu "Outdoor module integration"
   	  config OUTDOOR_MODULE_ENABLED
         boolean "Enable outdoor module integration"
         default true

   	  config OUTDOOR_MODULE_GPIO
         int "GPIO connected to outdoor module"
         default 2
   	  
   	  config OUTDOOR_MODULE_STATUS_TOPIC
         string "MQTT topic for outdoor module status"
         default "/acw/outdoor/0/status"
   endmenu
endmenu
```

## src/main_module/main/Kconfig.projbuild
```kconfig
menu "Auto-Close Window Settings"
   menu "WIFI Configuration"
   	  config WIFI_SSID
   	  	string "Wifi AP SSID"
   	  	default ""

   	  config WIFI_PASSWORD
   	  	string "Wifi AP Password"
   	  	default ""
   	  	
   	  config WIFI_TOPIC
   	  	string "WiFi MQTT Topic to listen Change-SSID command"
   	  	default "/acw/system/0/wifi/command"
   endmenu
   
   menu "MQTT Configuration"
      config MQTT_BROKER_URI
         string "Broker URL"
         default ""

      config MQTT_BROKER_USERNAME
	     string "Broker user name"
	     default ""

      config MQTT_BROKER_PASSWORD
	     string "Broker user password"
	     default ""
	     
	  config MQTT_TOPICS_PREFIX
	  	 string "Prefix for all topics"
	  	 default "/acw/0"
	  	 
	  config MQTT_HEALTHCHECK_ENABLED
	     boolean "Enable MQTT healthchecks"
	     default false
	  	 
	  config MQTT_HEALTHCHECK_TOPIC
	  	 string "Topic to send/read healthcheck pings"
	  	 default "/system/healthcheck"
	  	 
	  config MQTT_OTA_ENABLED
	     boolean "Enable MQTT OTA"
	     default false
	  	 
	  config MQTT_OTA_TOPIC
	  	 string "Topic to read OTA firmware URL"
	  	 default "/system/ota"
	  	 
	  config MQTT_OTA_VERSION_TOPIC
	  	 string "Topic to read OTA firmware URL"
	  	 default "/system/ota/version"
   endmenu
   
   menu "Stepper configuration"
   	  config PIN_STEPPER_ENABLE
   	  	 int "Stepper Enable# pin connected to"
   	  	 default 2

   	  config PIN_STEPPER_POWER_ON
   	  	 int "Stepper allow-power-on pin connected to"
   	  	 default 12
   	  	 
   	  config PIN_STEPPER_DIR
   	  	 int "Stepper Direction pin connected to"
   	  	 default 16

   	  config PIN_STEPPER_STEP
   	  	 int "Stepper One-Step pin connected to"
   	  	 default 17

   	  config ADC_STEPPER_LIMITSWITCH
   	  	 int "Stepper Limit switch ADC channel"
   	  	 default 4
   	  	 
   	  config ADC_STEPPER_NOISE_ALARM
   	  	 int "Noise alarm ADC channel"
   	  	 default 7
   	  	 
   	  menu "ADC measurement value"
   	  	  config ADC_STEPPER_CONNECTED_VALUE
   	  	  	 int "Stepper endstops connected value (percent)"
   	  	  	 default 90
   	  
	   	  config ADC_STEPPER_OPEN_VALUE
	   	  	 int "Stepper Full Open ADC value (percent)"
	   	  	 default 60
	   	  	 
	   	  config ADC_STEPPER_CLOSE_VALUE
	   	  	 int "Stepper Full Close ADC value (percent)"
	   	  	 default 20
	   	  	 
	   	  config ADC_STEPPER_NOISE_ALARM_VALUE
	   	  	 int "Noise alarm fired ADC value (percent)"
	   	  	 default 60
	   	  	 
	   	  config ADC_STEPPER_STEPPER_NOT_ALLOWED_VALUE
	   	  	 int "Window clamp not locked value (percent)"
	   	  	 default 0
	   	  	 
	   	  config ADC_STEPPER_DELTA_PC
	   	  	 int "Delta (int percent) from configured values"
	   	  	 default 7
   	  endmenu
   endmenu

   menu "FM configuration"
   	  config PIN_FM_OUT_433
   	  	 int "FM Sender 433MHz connected to"
   	  	 default 22

   	  config PIN_FM_IN_433
   	  	 int "FM Receiver 433MHz connected to"
   	  	 default 5
   	  	 
   	  config PIN_FM_IN_315
   	  	 int "FM Receiver 315MHz connected to"
   	  	 default 21
   	  	 
   	  config FM_TX_CARRIER_FREQ
   	  	 int "FM transmitter signal carrier frequency"
   	  	 default 40000
   endmenu

   menu "Charger"
   	  config PIN_CHARGER_START_BUTTON
   	  	 int "Charger button connected to"
   	  	 default 27

   	  config PIN_CHARGER_ENABLE
   	  	 int "Charger enable signal connected to"
   	  	 default 32
   endmenu
  
   menu "Controller2MQTT"
   	  config CONTROLLER_MQTT_COMMANDS_TOPIC
   	     string "MQTT topic to stepper listen commands"
   	     default "/controller/commands"

   	  config CONTROLLER_MQTT_STEPPER_STATUS_TOPIC
   	     string "MQTT topic to send stepper status"
   	     default "/controller/status/stepper"

   	  config CONTROLLER_MQTT_AIR_STATUS
   	     string "MQTT topic to send outdoor air status"
   	     default "/controller/air/status"

   	  config CONTROLLER_MQTT_NOISE_STATUS
   	     string "MQTT topic to send outdoor noise status"
   	     default "/controller/noise/status"

   	  config CONTROLLER_MQTT_NOISE_ALARM
   	     string "MQTT topic to send outdoor noise alarms"
   	     default "/controller/noise/alarm"

   	  config CONTROLLER_MQTT_HM_BAT_STATUS
   	     string "MQTT topic to send handle module bat status messages"
   	     default "/controller/hm/batstatus"

   	  config CONTROLLER_MQTT_OM_BAT_STATUS
   	     string "MQTT topic to send outdoor module bat status messages"
   	     default "/controller/om/batstatus"
   	     
   	  config CONTROLLER_MQTT_STEPPER_ERROR
   	     string "MQTT topic to send stepper error status"
   	     default "/controller/status/positionerror"
   	     
   	  config CONTROLLER_MQTT_LIMIT_SWITCH_ENABLE_STATUS
   	     string "MQTT topic to send limit switch status"
   	     default "/controller/status/lsw"
   	  
   	  config CONTROLLER_MQTT_STEPPER_POSITION
   	     string "MQTT topic to send stepper position value"
   	     default "/controller/position"
   	     
   	  config CONTROLLER_MQTT_STEPPER_NOISE_ALARM_STATUS
   	     string "MQTT topic to send stepper noise alarm status"
   	     default "/controller/status/steppernoisealarm"
   endmenu
 endmenu
 
 
```
